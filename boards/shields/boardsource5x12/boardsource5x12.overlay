/*
 * Copyright (c) 2021 The ZMK Contributors
 *
 * SPDX-License-Identifier: MIT
 */

#include <dt-bindings/zmk/matrix_transform.h>
/ {
    chosen {
        zmk,kscan = &default_kscan;
        zmk,matrix-transform = &default_transform;
    };

    default_kscan: kscan {
      compatible = "zmk,kscan-gpio-matrix";
      label = "default_kscan";
      diode-direction = "col2row";
      wakeup-source;
        
      col-gpios = 
        <&pro_micro_d 16 GPIO_ACTIVE_HIGH>;

      row-gpios =
        <&pro_micro_d 9 (GPIO_ACTIVE_HIGH | GPIO_PULL_DOWN)>;
    };
    };