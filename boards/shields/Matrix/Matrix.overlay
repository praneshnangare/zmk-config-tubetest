/ {
  chosen {
    zmk,kscan = &defualt_kscan;
  };

  defualt_kscan: kscan {
    compatible = "zmk,kscan-gpio-matrix";
    label = "defualt_kscan";
    diode-direction = "col2row";

    col-gpios = 
      <&pro_micro 20 GPIO_ACTIVE_HIGH>,
      <&pro_micro 19 GPIO_ACTIVE_HIGH>,
      <&pro_micro 18 GPIO_ACTIVE_HIGH>,
      <&pro_micro 17 GPIO_ACTIVE_HIGH>,
      <&pro_micro 16 GPIO_ACTIVE_HIGH>,
      <&pro_micro 15 GPIO_ACTIVE_HIGH>,
      <&pro_micro 14 GPIO_ACTIVE_HIGH>;

    row-gpios =
      <&pro_micro 7 GPIO_ACTIVE_HIGH>,
      <&pro_micro 8 GPIO_ACTIVE_HIGH>,
      <&pro_micro 9 GPIO_ACTIVE_HIGH>,
      <&pro_micro 10 GPIO_ACTIVE_HIGH>,
      <&pro_micro 11 GPIO_ACTIVE_HIGH>,
      <&pro_micro 12 GPIO_ACTIVE_HIGH>;
  };
};